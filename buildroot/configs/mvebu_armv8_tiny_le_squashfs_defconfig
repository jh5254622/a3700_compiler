## buildroot/configs/mvebu_armv8_tiny_le_squashfs_defconfig
```kconfig
BR2_aarch64=y
BR2_DEPRECATED=y
BR2_DEPRECATED_SINCE_2015_02=y
BR2_DEPRECATED_SINCE_2015_05=y
BR2_DEPRECATED_SINCE_2015_08=y
BR2_TOOLCHAIN_EXTERNAL=y
BR2_TOOLCHAIN_EXTERNAL_CUSTOM=y
BR2_TOOLCHAIN_EXTERNAL_PATH=""
BR2_TOOLCHAIN_EXTERNAL_CUSTOM_PREFIX="aarch64-marvell-linux-gnu"
BR2_TOOLCHAIN_EXTERNAL_PREFIX="aarch64-marvell-linux-gnu"
BR2_TOOLCHAIN_EXTERNAL_GLIBC=y
BR2_TOOLCHAIN_EXTERNAL_GCC_5=y
BR2_TOOLCHAIN_EXTERNAL_HEADERS_3_18=y
BR2_TOOLCHAIN_EXTERNAL_CUSTOM_GLIBC=y
BR2_TARGET_GENERIC_HOSTNAME="airdisk"
BR2_TARGET_GENERIC_ISSUE="Welcome to airdisk_NAS"
BR2_MVEBU_RELEASE_NAME="16.06.0"
BR2_TARGET_GENERIC_PASSWD_MD5=y
BR2_TARGET_GENERIC_PASSWD_METHOD="md5"
BR2_INIT_BUSYBOX=y
BR2_ROOTFS_DEVICE_CREATION_DYNAMIC_DEVTMPFS=y
BR2_ROOTFS_DEVICE_TABLE="system/device_table.txt"
BR2_ROOTFS_SKELETON_DEFAULT=y
BR2_TARGET_ENABLE_ROOT_LOGIN=y
BR2_TARGET_GENERIC_ROOT_PASSWD="ffffff"
BR2_SYSTEM_BIN_SH_BUSYBOX=y

BR2_SYSTEM_BIN_SH="busybox"
BR2_TARGET_GENERIC_GETTY=y
BR2_TARGET_GENERIC_GETTY_PORT="console"
BR2_TARGET_GENERIC_GETTY_BAUDRATE_KEEP=y
BR2_TARGET_GENERIC_GETTY_BAUDRATE="0"
BR2_TARGET_GENERIC_GETTY_TERM="vt100"
BR2_TARGET_GENERIC_GETTY_OPTIONS=""
BR2_TARGET_GENERIC_REMOUNT_ROOTFS_RW=y
BR2_SYSTEM_DHCP=""
BR2_ROOTFS_USERS_TABLES=""
BR2_ROOTFS_OVERLAY="user_files"
BR2_ROOTFS_POST_BUILD_SCRIPT=""
BR2_ROOTFS_POST_IMAGE_SCRIPT="board/marvell/scripts/filesystem-post-script.sh"
BR2_PACKAGE_MTD=y
# BR2_PACKAGE_MTD_FLASHCP is not set
# BR2_PACKAGE_MTD_FLASH_ERASE is not set
# BR2_PACKAGE_MTD_FLASH_LOCK is not set
# BR2_PACKAGE_MTD_FLASH_UNLOCK is not set
# BR2_PACKAGE_MTD_NANDDUMP is not set
# BR2_PACKAGE_MTD_NANDTEST is not set
# BR2_PACKAGE_MTD_NANDWRITE is not set
# BR2_PACKAGE_MTD_MTDINFO is not set
# BR2_PACKAGE_MTD_UBIATTACH is not set
# BR2_PACKAGE_MTD_UBICRC32 is not set
# BR2_PACKAGE_MTD_UBIDETACH is not set
# BR2_PACKAGE_MTD_UBIFORMAT is not set
# BR2_PACKAGE_MTD_UBIMKVOL is not set
# BR2_PACKAGE_MTD_UBINFO is not set
# BR2_PACKAGE_MTD_UBINIZE is not set
# BR2_PACKAGE_MTD_UBIRENAME is not set
# BR2_PACKAGE_MTD_UBIRMVOL is not set
# BR2_PACKAGE_MTD_UBIRSVOL is not set
# BR2_PACKAGE_MTD_UBIUPDATEVOL is not set
# BR2_PACKAGE_MTD_UBIBLOCK is not set
BR2_PACKAGE_STRACE=y
BR2_PACKAGE_I2C_TOOLS=y
BR2_PACKAGE_NCURSES=y
BR2_PACKAGE_POPT=y
BR2_PACKAGE_READLINE=y
BR2_PACKAGE_IPERF3=y

BR2_PACKAGE_SAMBA=y
BR2_PACKAGE_SAMBA_MAX_DEBUGLEVEL=-1
# BR2_PACKAGE_SAMBA_NET is not set
# BR2_PACKAGE_SAMBA_EVENTLOGADM is not set
BR2_PACKAGE_SAMBA_NMBD=y
BR2_PACKAGE_SAMBA_NMBLOOKUP=y
# BR2_PACKAGE_SAMBA_NTLM_AUTH is not set
# BR2_PACKAGE_SAMBA_PDBEDIT is not set
# BR2_PACKAGE_SAMBA_PROFILES is not set
# BR2_PACKAGE_SAMBA_RPCCLIENT is not set
# BR2_PACKAGE_SAMBA_SMBCACLS is not set
# BR2_PACKAGE_SAMBA_SMBCLIENT is not set
# BR2_PACKAGE_SAMBA_SMBCONTROL is not set
# BR2_PACKAGE_SAMBA_SMBCQUOTAS is not set
BR2_PACKAGE_SAMBA_SMBD=y
# BR2_PACKAGE_SAMBA_SMBGET is not set
# BR2_PACKAGE_SAMBA_SMBLDBTOOLS is not set
# BR2_PACKAGE_SAMBA_SMBPASSWD is not set
# BR2_PACKAGE_SAMBA_SMBSHARESEC is not set
# BR2_PACKAGE_SAMBA_SMBSPOOL is not set
# BR2_PACKAGE_SAMBA_SMBSTATUS is not set
# BR2_PACKAGE_SAMBA_SMBTREE is not set
# BR2_PACKAGE_SAMBA_SWAT is not set
# BR2_PACKAGE_SAMBA_SMBTA_UTIL is not set
# BR2_PACKAGE_SAMBA_TDB is not set
# BR2_PACKAGE_SAMBA_TESTPARM is not set
# BR2_PACKAGE_SAMBA_WINBINDD is not set
BR2_PACKAGE_BASE_FILES=y
BR2_PACKAGE_DMTEST=y
BR2_TARGET_ROOTFS_CPIO=y
BR2_TARGET_ROOTFS_CPIO_NONE=y
BR2_TARGET_ROOTFS_SQUASHFS=y
BR2_TARGET_ROOTFS_SQUASHFS4_GZIP=y
BR2_TARGET_ROOTFS_TAR=y
BR2_TARGET_ROOTFS_TAR_GZIP=y
BR2_TARGET_ROOTFS_TAR_OPTIONS=""
BR2_PACKAGE_HOST_E2FSPROGS=y
BR2_PACKAGE_HOST_GENEXT2FS=y
BR2_PACKAGE_HOST_MKE2IMG=y
```

## buildroot/package/base-files/Config.in
```kconfig
config BR2_PACKAGE_BASE_FILES
	bool "base-files"
	help
	  The basics files and scripts for both airdisk system
```
